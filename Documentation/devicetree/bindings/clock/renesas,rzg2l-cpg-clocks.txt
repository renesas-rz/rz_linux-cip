## Documentation/devicetree/bindings/net/dsa/renesas,rzt2h-ethsw.yaml
```yaml
# SPDX-License-Identifier: (GPL-2.0-only OR BSD-2-Clause)
%YAML 1.2
---
$schema: http://devicetree.org/meta-schemas/core.yaml#

title: Renesas RZ/T2H Ethernet Switch

description: |
  The Ethernet switch is present on the Renesas RZ/T2H SoC family and
  handles 3 ports + 1 CPU management port.

allOf:
  - $ref: dsa.yaml#/$defs/ethernet-ports

properties:
  compatible:
    items:
      - const: renesas,rzt2h-ethsw

  reg:
    maxItems: 1

  interrupts:
    items:
      - description: Device Level Ring (DLR) interrupt
      - description: Switch interrupt
      - description: Parallel Redundancy Protocol (PRP) interrupt
      - description: Integrated HUB module interrupt
      - description: Receive Pattern Match interrupt

  interrupt-names:
    items:
      - const: dlr
      - const: switch
      - const: prp
      - const: hub
      - const: ptrn

  power-domains:
    maxItems: 1

  mdio:
    $ref: /schemas/net/mdio.yaml#
    unevaluatedProperties: false

  clocks:
    items:
      - description: Switch system clock

  ethernet-ports:
    type: object
    properties:
      '#address-cells':
        const: 1
      '#size-cells':
        const: 0

    patternProperties:
      "^(ethernet-)?port@[0-3]$":
        type: object
        description: Ethernet switch ports

        properties:
          pcs-handle:
            maxItems: 1
            description:
              phandle pointing to a PCS sub-node compatible with
              renesas,rzt2h-ethss.yaml#

unevaluatedProperties: false

required:
  - compatible
  - reg
  - clocks
  - power-domains

examples:
  - |
   #include <dt-bindings/interrupt-controller/arm-gic.h>
   #include <dt-bindings/clock/r9a09g077-cpg.h>

	ethsw: ethsw@80120000 {
	        compatible = "renesas,rzt2h-ethsw";
	        reg =  <0 0x80120000 0 0x10000>;
	        clocks = <&cpg CPG_MOD R9A09G077_ETHSW_CLK>;
	        resets = <&cpg R9A09G077_ETHSW_RST>;
	        power-domains = <&cpg>;
	        status = "disabled";

	        ethernet-ports {
	                #address-cells = <1>;
	                #size-cells = <0>;

	                switch_port0: port@0 {
	                        reg = <0>;
	                        pcs-handle = <&mii_conv0>;
	                        label = "lan0";
	                        phy-mode = "mii";
	                        phy-handle = <&phy0>;
	                        status = "okay";
	                };

	                switch_port1: port@1 {
	                        reg = <1>;
	                        pcs-handle = <&mii_conv1>;
	                        label = "lan1";
	                        phy-mode = "mii";
	                        phy-handle = <&phy1>;
	                        status = "okay";
	                };

	                switch_port2: port@2 {
	                        reg = <2>;
	                        pcs-handle = <&mii_conv2>;
	                        label = "lan2";
	                        phy-mode = "mii";
	                        phy-handle = <&phy2>;
	                        status = "okay";
	                };

	                switch_port3: port@3 {
	                        reg = <3>;
	                        ethernet = <&gmac0>;
	                        label = "cpu";
	                        phy-mode = "internal";
	                        status = "okay";
	                        fixed-link {
	                                speed = <1000>;
	                                full-duplex;
	                        };
	                };
	        };

		mdio {
		        clock-frequency = <2500000>;

		        #address-cells = <1>;
		        #size-cells = <0>;

		        phy0: ethernet-phy@0 {
		                compatible = "ethernet-phy-id0007.0772";
		                phy-mode = "mii";
		                reg = <0>;
		        };

		        phy1: ethernet-phy@1 {
		                compatible = "ethernet-phy-id0007.0772";
		                phy-mode = "mii";
		                reg = <1>;
		        };

		        phy2: ethernet-phy@2 {
		                compatible = "ethernet-phy-id0007.0772";
		                phy-mode = "mii";
		                reg = <2>;
		        };
		};
	};
```

## Documentation/devicetree/bindings/net/renesas,rzt2h-ethss.yaml
```yaml
# SPDX-License-Identifier: (GPL-2.0-only OR BSD-2-Clause)
%YAML 1.2
---
$id: http://devicetree.org/schemas/net/renesas,rzt2h-ethss.yaml#
$schema: http://devicetree.org/meta-schemas/core.yaml#

title: Renesas RZ/T2H Ethernet Subsystem

description: |
  This Ethernet Subsystem is present on the Renesas RZ/T2H SoC family. It is
  responsible to do MII passthrough or convert it to RMII/RGMII.

properties:
  '#address-cells':
    const: 1

  '#size-cells':
    const: 0

  compatible:
    items:
      - const: renesas,rzt2h-ethss

  reg:
    maxItems: 1

  clocks:
    items:
      - description: Clock used for the MII converter register interface

  renesas,ethss-switch-portmanagement:
    description: ETHSS Switch Management port configuration. This value should use one of
      the values defined in dt-bindings/net/rzt2h-ethss.h.
    $ref: /schemas/types.yaml#/definitions/uint32

  power-domains:
    maxItems: 1

patternProperties:
  "^mii-conv@[0-5]$":
    type: object
    description: MII converter port

    properties:
      reg:
        description: MII Converter port number.
        enum: [0, 1, 2, 3]

      renesas,ethss-port:
        description: Converter input port configuration. This value should use
          one of the values defined in dt-bindings/net/rzt2h-ethss.h.
        $ref: /schemas/types.yaml#/definitions/uint32

    required:
      - reg
      - renesas,ethss-port

    additionalProperties: false

required:
  - '#address-cells'
  - '#size-cells'
  - compatible
  - reg
  - clocks
  - power-domains

additionalProperties: false

examples:
  - |
    #include <dt-bindings/net/rzt2h-ethss.h>

	ethss: ethss@80110000 {
	        compatible = "renesas,rzt2h-ethss";
	        #address-cells = <1>;
	        #size-cells = <0>;
	        reg =  <0 0x80110000 0 0x10000>;
	        clocks = <&cpg CPG_MOD R9A09G077_ETHSS_CLK>;
	        resets = <&cpg R9A09G077_ETH_SUBSYSTEM_RST>,
	                 <&cpg R9A09G077_MII_CONVERT_RST>;
	        reset-names = "reset_ethss", "reset_conv";
	        power-domains = <&cpg>;
	        status = "disabled";

	        mii_conv0: mii-conv@0 {
	                reg = <0>;
	                status = "disabled";
	        };

	        mii_conv1: mii-conv@1 {
	                reg = <1>;
	                status = "disabled";
	        };

	        mii_conv2: mii-conv@2 {
	                reg = <2>;
	                status = "disabled";
	        };

	        mii_conv3: mii-conv@3 {
	                reg = <3>;
	                status = "disabled";
	        };
	};
```

## Documentation/devicetree/bindings/pinctrl/renesas,rzg2l-pinctrl.txt
```
Renesas RZ/G2L and RZ/V2L combined Pin and GPIO controller

The Renesas SoCs of the RZ/G2L and RZ/V2L family feature a combined Pin and GPIO controller,
named "P" in the hardware reference manual.
Pin multiplexing and GPIO configuration is performed on a per-pin basis
writing configuration values to per-port register sets.
Each "port" features up to 8 pins, each of them configurable for GPIO
function (port mode) or in alternate function mode.
Up to 4 different alternate function modes exist for each single pin.

Pin controller node
-------------------

Required properties:
  - compatible: should be:
    - "renesas,r9a07g044l-pinctrl": for R9A07G044L SoC.
    - "renesas,r9a07g054l-pinctrl": for R9A07G054L SoC.

  - reg: include 2 areas:
    1st: address base and length of the memory area where the pin controller
         hardware is mapped to.
    2nd: address base and length of the memory area where the interrupt
         controller hardware is mapped to.
         Here is a part of IA55 module's area.

Example:
Pin controller node for R9A07G044L SoC.

pinctrl: pin-controller@11030000 {
	compatible = "renesas,r9a07g044l-pinctrl";

	reg = <0 0x11030000 0 0x10000>, <0 0x110a0020 0 0x30>;
};

The PFC node also acts as a container for pin configuration nodes. Please refer
to pinctrl-bindings.txt in this directory for the definition of the term "pin
configuration node" and for the common pinctrl bindings used by client devices.

Each pin configuration node represents a desired configuration for a pin, a
pin group, or a list of pins or pin groups. The configuration can include the
function to select on those pin(s) and pin configuration parameters (such as
pull-up and pull-down).

Pin configuration nodes contain pin configuration properties, either directly
or grouped in child subnodes. Both pin muxing and configuration parameters can
be grouped in that way and referenced as a single pin configuration node by
client devices.

A configuration node or subnode must reference at least one pin (through the
pins or pin groups properties) and contain at least a function or one
configuration parameter. When the function is present only pin groups can be
used to reference pins.

All pin configuration nodes and subnodes names are ignored. All of those nodes
are parsed through phandles and processed purely based on their content.

Pin Configuration Node Properties:

- pins : An array of strings, each string containing the name of a pin.
- groups : An array of strings, each string containing the name of a pin
  group.

- function: A string containing the name of the function to mux to the pin
  group(s) specified by the groups property.

  Valid values for pin, group and function names can be found in the group and
  function arrays of the PFC data file corresponding to the SoC
  (drivers/pinctrl/rzg2l/pinctrl-*.c)

The pin configuration parameters use the generic pinconf bindings defined in
pinctrl-bindings.txt in this directory. The supported parameters are
bias-disable, bias-pull-up, bias-pull-down, drive-strength, slew-rate, input-enable.

  Example: pin control maps for the SCIF2 devices
	&pinctrl {
		scif2_pins: scif2 {
			groups = "scif2_data_a", "scifa2_ctrl_a";
			function = "scif2";
		};
	};

- GPIO controller:
In RZ/G2L, the PFC node is also a GPIO controller node.

Required properties:
- gpio-controller
  empty property as defined by the GPIO bindings documentation.
- #gpio-cells
  number of cells required to identify and configure a GPIO.
  Shall be 2. The first cell is the GPIO number and the second
  cell specifies GPIO flags, as defined in <dt-bindings/gpio/gpio.h>.
  Only the GPIO_ACTIVE_HIGH and GPIO_ACTIVE_LOW flags are supported.
- gpio-ranges
  Describes a GPIO controller specifying its specific pin base, the pin
  base in the global pin numbering space, and the number of controlled
  pins, as defined by the GPIO bindings documentation. Refer to
  Documentation/devicetree/bindings/gpio/gpio.txt file for a more detailed
  description.
- interrupts: Interrupt specifier for the controllers interrupt.

The syntax of the gpio specifier used by client nodes should be the following
with values derived from the SoC user manual.
  <[phandle of the gpio controller node]
   [pin number within the gpio controller]
   [flags]>

  Example: A GPIO LED node that references a GPIO P1_0
	#include <dt-bindings/gpio/gpio.h>
	#include <dt-bindings/pinctrl/pinctrl-rzg2l.h>
	led1 {
		compatible = "gpio-leds";
		gpios = <&pinctrl RZG2L_GPIO(1, 0) GPIO_ACTIVE_LOW>;
	};

The GPIO controller also acts as an interrupt controller.
Required properties:
- interrupt-controller
  Empty property that mark this node as an interrupt controller.
- #interrupt-cells
  It uses the default two cells specifier as described in
  Documentation/devicetree/bindings/interrupt-controller/interrupts.txt.
  Currently, GPIO interrupt can only support edge trigger condition:
  + Rising.
  + Falling.

  Example: A GPIO pin (P1_1) is used as GPIO interrupt
	#include <dt-bindings/interrupt-controller/arm-gic.h>
	#include <dt-bindings/pinctrl/pinctrl-rzg2l.h>
	&eth0 {
		...

		phy0: ethernet-phy@7 {
			...
			interrupt-parent = <&pinctrl>;
			interrupts = <RZG2L_GPIO(1, 0) IRQ_TYPE_EDGE_FALLING>;
			...
		};
	};
```

## Documentation/devicetree/bindings/power/renesas,rcar-sysc.txt
```
DT bindings for the Renesas R-Car System Controller

== System Controller Node ==

The R-Car System Controller provides power management for the CPU cores and
various coprocessors.

Required properties:
  - compatible: Must contain exactly one of the following:
      - "renesas,r8a7742-sysc" (RZ/G1H)
      - "renesas,r8a7743-sysc" (RZ/G1M)
      - "renesas,r8a7744-sysc" (RZ/G1N)
      - "renesas,r8a7745-sysc" (RZ/G1E)
      - "renesas,r8a77470-sysc" (RZ/G1C)
  - reg: Address start and address range for the device.
  - #power-domain-cells: Must be 1.

Example:

	 sysc: system-controller@e6180000 {
		compatible = "renesas,r8a7742-sysc";
		reg = <0 0xe6180000 0 0x0200>;
		#power-domain-cells = <1>;
	};


== PM Domain Consumers ==

Devices residing in a power area must refer to that power area, as documented
by the generic PM domain bindings in
Documentation/devicetree/bindings/power/power_domain.txt.

Required properties:
  - power-domains: A phandle and symbolic PM domain specifier, as defined in
		   <dt-bindings/power/r8a77*-sysc.h>.

Example:

	L2_CA15: cache-controller@0 {
		compatible = "cache";
		power-domains = <&sysc R8A7743_PD_CA15_SCU>;
		cache-unified;
		cache-level = <2>;
	};
```

## Documentation/devicetree/bindings/pwm/gpt-rzt2h.txt
```
* Renesas RZ/T2H GPT Timer Controller

Required Properties:
- compatible: Must be "renesas,gpt-r9a09g077".
- reg: Base address and length of the registers block for the PWM.
- #pwm-cells: Should be 2. See pwm.txt in this directory for a description of
  the cells format.
- interrupts: IRQ line for GPT.
- interrupt-names: Name of IRQ lines.
- clocks: Clock phandle and specifier pair.
- clock-names: Name of clocks.
- pinctrl-0: phandle, referring to a default pin configuration node.
- pinctrl-names: Set to "default".
- channel : Output channel for GPT, to set this refer to output pin and
 one of the following:
	- "channel_A": use only channel A for output
	- "channel_B": use only channel B for output
	- "both_AB": use both channel A and B for output, this is double output mode


Optional properties:
- poeg: referring to a poeg node, if not set this property, GPT not
  use poeg

Example:

gpt02_0: gpt02_0@90004000 {
	compatible = "renesas,gpt-r9a09g077";
	reg = <0 0x90004000 0 0x100>,
		<0 0x80290000 0 0x0c>,
		<0 0x802a0000 0 0x1000>,
		<0 0x812a0000 0 0x100>;
	reg-names = "base1", "base2",
		    "ns_int_base", "s_int_base";
	#pwm-cells = <2>;
	interrupts = <GIC_SPI 887 IRQ_TYPE_EDGE_RISING>,
			<GIC_SPI 888 IRQ_TYPE_EDGE_RISING>,
			<GIC_SPI 147 IRQ_TYPE_EDGE_RISING>,
			<GIC_SPI 148 IRQ_TYPE_EDGE_RISING>,
			<GIC_SPI 149 IRQ_TYPE_EDGE_RISING>,
			<GIC_SPI 150 IRQ_TYPE_EDGE_RISING>,
			<GIC_SPI 151 IRQ_TYPE_EDGE_RISING>;
	interrupt-names = "adtrga", "adtrgb", "int0", "int1",
			  "int2", "int3", "int4";
	clocks = <&cpg CPG_MOD R9A09G077_GPT2_PCLK>;
	power-domains = <&cpg>;
	status = "disabled";
};

&gpt02_0 {
	pinctrl-0 = <&gpt02_0_pins>;
	pinctrl-names = "default";
	channel = "both_AB";
	poeg = <&poegd>;
	status = "okay";
};
```
