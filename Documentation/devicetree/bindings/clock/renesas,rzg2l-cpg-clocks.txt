## Documentation/devicetree/bindings/clock/renesas,rzg2l-cpg-clocks.txt
```
* Renesas RZ/G2L and RZ/V2L Clock Pulse Generator (CPG)

The CPG generates core clocks for the RZ/G2L and RZ/V2L SoCs. It includes the PLL, variable
CPU and GPU clocks, and several fixed ratio dividers.
The CPG also provides a Clock Domain for SoC devices, in combination with the
CPG Module Stop (MSTP) Clocks.

Required Properties:

  - compatible: Must be one of
    - "renesas,r9a07g044l-cpg" for the r9a07g044l CPG
    - "renesas,r9a07g054l-cpg" for the r9a07g054l CPG
  - reg: Base address and length of the memory resource used by the CPG
  - clocks: References to possible external input clocks,
	one entry for each entry in clock-names
  - clock-names: References to possible input clock names. Valid list as below:
	"xinclk" (r9a07g044l, r9a07g054l)
  - #clock-cells: Must be 2

Examples
--------

  - CPG device node:

	cpg: clock-controller@11010000 {
		compatible = "renesas,r9a07g044l-cpg";
		reg = <0  0x11010000 0 0x10000>;
		clocks = <&xinclk>;
		clock-names = "xinclk";
		#clock-cells = <2>;
	};


  - CPG/MSTP Clock Domain member device node:

	gic: interrupt-controller@11900000 {
		compatible = "arm,gic-v3";
		#interrupt-cells = <3>;
		#address-cells = <0>;
		interrupt-controller;
		reg = <0x0 0x11900000 0 0x20000>,
		<0x0 0x11960000 0 0x20000>;
		clocks = <&cpg CPG_MOD R9A07G044L_CLK_GIC600>;
		clock-names = "gic6000";
		interrupts = <GIC_PPI 25
			(GIC_CPU_MASK_SIMPLE(2) | IRQ_TYPE_LEVEL_LOW)>;
	};
```

## Documentation/devicetree/bindings/clock/renesas,versaclock3.txt
```
Binding for Renesas VersaClock 3 programmable i2c clock generators.

The Renesas VersaClock 3 is programmable i2c clock generators providing
from 5 to 7 output clocks.

==I2C device node==

Required properties:
- compatible:	must be
		"renesas,5p35023"
- reg:		i2c device address, shall be 0x68 or 0x69 or 0x6a or 0x6b.
- #clock-cells:	from common clock binding; shall be set to 1.
- clocks:	from common clock binding; list of parent clock handles,
		- 5p35023: either X1 or CLKIN reference clock.
- clock-names:	from common clock binding; clock input names, can be
		- 5p35023: (required) either "x1" or "clkin".
- clock-divider-read-only:	(optional) specify divider is read only or not.
- clock-flags: (optional) specify clock flags.

==Mapping between clock specifier and physical pins==

When referencing the provided clock in the DT using phandle and
clock specifier, the following mapping applies:

5P35023:
	0 -- DIFF2
	1 -- DIFF1
	2 -- SE3
	3 -- SE2
	4 -- SE1
	5 -- Ref

==Example==

/* 24MHz reference crystal */
x1_clk: x1-clock {
	compatible = "fixed-clock";
	#clock-cells = <0>;
	clock-frequency = <24000000>;
};

i2c-master-node {

	/* Renesas 5P35023 i2c clock generator */
	versa3: versa3@68 {
		compatible = "renesas,5p35023";
		reg = <0x68>;
		#clock-cells = <1>;

		/* Connect X1 input to 24MHz reference */
		clocks = <&x1_clk>;
		clock-names = "x1";
	};
};

/* Consumer referencing the 5P35023 pin SE2 */
consumer {
	...
	clocks = <&versa3 3>;
	...
}
```

## Documentation/devicetree/bindings/dma/renesas,rzg2l-dma.txt
```
* Direct Memory Access (DMA) Controller Device Tree bindings for RZG2L

* DMA controller

Required properties:
- compatible : Should be "renesas,<soctype>-dma".
	Below is soctypes supported:
	  - "renesas,r9a07g044l-dma" (RZ/G2L)
	  - "renesas,r9a07g054l-dma" (RZ/V2L)
- reg : First item should be contain DMA channel 0 base registers location and
  length.Second item should be DMA Extension Resource Selectors registers
  location and length
- interrupts : Interrupt specifiers for the DMAC, one for each entry in
  interrupt-names
- interrupt-names: One entry for the error interrupt, named "error", plus one
  entry per channel, named "ch%u", where %u is the channel number ranging from
  zero to the number of channels minus one
- dma-channels : Number of DMA channels supported. Should be 16
- #dma-cells : Has to be 1. rzg2l-dma does not support anything else

- clocks:  phandle + clock-specifier pairs for DMA functional clock
- resets: Reference to a reset controller asserting the DMA controller
Example:

	dma0: dma-controller@11800000 {
		compatible = "renesas,r9a07g044l-dma";
		reg =   <0 0x11820000 0 0x10000>,
			<0 0x11830000 0 0x10000>;

		interrupts =    <GIC_SPI 125 IRQ_TYPE_EDGE_RISING>,
			<GIC_SPI 126 IRQ_TYPE_EDGE_RISING>,
			<GIC_SPI 127 IRQ_TYPE_EDGE_RISING>,
			<GIC_SPI 128 IRQ_TYPE_EDGE_RISING>,
			<GIC_SPI 129 IRQ_TYPE_EDGE_RISING>,
			<GIC_SPI 130 IRQ_TYPE_EDGE_RISING>,
			<GIC_SPI 131 IRQ_TYPE_EDGE_RISING>,
			<GIC_SPI 132 IRQ_TYPE_EDGE_RISING>,
			<GIC_SPI 133 IRQ_TYPE_EDGE_RISING>,
			<GIC_SPI 134 IRQ_TYPE_EDGE_RISING>,
			<GIC_SPI 135 IRQ_TYPE_EDGE_RISING>,
			<GIC_SPI 136 IRQ_TYPE_EDGE_RISING>,
			<GIC_SPI 137 IRQ_TYPE_EDGE_RISING>,
			<GIC_SPI 138 IRQ_TYPE_EDGE_RISING>,
			<GIC_SPI 139 IRQ_TYPE_EDGE_RISING>,
			<GIC_SPI 140 IRQ_TYPE_EDGE_RISING>,
			<GIC_SPI 141 IRQ_TYPE_EDGE_RISING>;
		interrupt-names = "ch0", "ch1", "ch2", "ch3",
			"ch4", "ch5", "ch6", "ch7",
			"ch8", "ch9", "ch10", "ch11",
			"ch12", "ch13", "ch14", "ch15",
			"error";
		dma-channels = <16>;
		#dma-cells = <1>;
		clocks = <&cpg CPG_MOD R9A07G044L_CLK_DMAC>;
		resets = <&cpg R9A07G044L_CLK_DMAC>;
	};

* DMA client

Clients have to specify the DMA requests with phandles in a list.

Required properties:
- dmas: List of one or more DMA request specifiers. One DMA request specifier
  consists of a phandle to the DMA controller followed by the number
  specifying the module request type. The number includes 8 bits MSB MID
  and 4 bits LSB RID.
- dma-names: List of string identifiers for the DMA requests. For the correct
  names, have a look at the specific client driver.

Example:

	&ssi0 {
		...
		dmas = <&dma0 0x9501>,
			<&dma0 0x9502>;
		dma-names = "tx", "rx";
		...
	};
```

## Documentation/devicetree/bindings/i2c/i2c-riic.txt
```
Device tree configuration for Renesas RIIC driver

Required properties:
- compatible      :
	"renesas,riic-r9a07g044l" if the device is a part of a R9A07G044L SoC.
	"renesas,riic-r7s72100" if the device is a part of a R7S72100 SoC.
	"renesas,riic-rz" for a generic RZ/A1, RZ/A2 or RZ/G2L compatible device.

	When compatible with the generic version, nodes must list the
	SoC-specific version corresponding to the platform first followed
	by the generic version.

- reg             : address start and address range size of device
- interrupts      : 8 interrupts (TEI, RI, TI, SPI, STI, NAKI, ALI, TMOI)
- clock-frequency : frequency of bus clock in Hz
- #address-cells  : should be <1>
- #size-cells     : should be <0>

Pinctrl properties might be needed, too. See there.

Example:

	i2c0: i2c@fcfee000 {
		compatible = "renesas,riic-r7s72100", "renesas,riic-rz";
		reg = <0xfcfee000 0x44>;
		interrupts = <0 157 IRQ_TYPE_LEVEL_HIGH>,
			     <0 158 IRQ_TYPE_EDGE_RISING>,
			     <0 159 IRQ_TYPE_EDGE_RISING>,
			     <0 160 IRQ_TYPE_LEVEL_HIGH>,
			     <0 161 IRQ_TYPE_LEVEL_HIGH>,
			     <0 162 IRQ_TYPE_LEVEL_HIGH>,
			     <0 163 IRQ_TYPE_LEVEL_HIGH>,
			     <0 164 IRQ_TYPE_LEVEL_HIGH>;
		clock-frequency = <100000>;
		#address-cells = <1>;
		#size-cells = <0>;
	};
```

## Documentation/devicetree/bindings/iio/adc/rzg2l-adc.txt
```
Renesas RZ/G2L A/D Converter bindings

Required properties:
- compatible: should be "renesas,rzg2l-adc"

- reg: physical base address of the controller and length of memory mapped
       region.
- interrupts: The interrupt number to the cpu. The interrupt specifier format
              depends on the interrupt controller.
- clocks: Must contain an entry for each entry in clock-names.
- #io-channel-cells: Should be 1, see ../iio-bindings.txt
- resets: Must contain an entry for each entry in reset-names if need support
	  this option. See ../reset/reset.txt for details.

Example:
	adc: adc@10059000 {
		compatible = "renesas,rzg2l-adc";
		reg = <0 0x10059000 0 0x400>;
		interrupts = <GIC_SPI 347  IRQ_TYPE_EDGE_RISING>;
		clocks = <&cpg CPG_MOD R9A07G044L_CLK_ADC>;
		resets = <&cpg R9A07G044L_CLK_ADC>;
		power-domains = <&cpg>;
	};
```

## Documentation/devicetree/bindings/iio/adc/rzt2h-adc.txt
```
* Renesas RZ/T2H ADC device driver

The Renesas RZ/T2H supply 3 ADC units with 4 or 12 chanels per unit.

Required properties:
- compatible:	Must be set to "renesas,rzt2h-adc".
- reg:		Address and length of the register set for the device.
- clocks:	References to all the clocks specified in the clock-names
		property as specified in
		Documentation/devicetree/bindings/clock/clock-bindings.txt.
- clock-names:	Name of clock.
- power-domains: Must contain a reference to the PM domain, if available.
- #address-cells: Should be <1> (setting for the subnodes) for all ADC units.
- #size-cells:	Should be <0> (setting for the subnodes).

Optional properties:
- interrupt: IRQ line for the RTC.
- interrupt-name: Name of interrupt line.

Sub-nodes:
You must define subnode(s) which select the connected ADC type and reference
voltage for the ADC channels.

Required properties for subnodes:
- reg:		Should be the number of the analog input.

Example:
	adc0@90014000 {
		compatible = "renesas,rzt2h-adc";
		reg = <0 0x90014000 0 0x400>;;
		interrupts =	<GIC_SPI 698 IRQ_TYPE_EDGE_RISING>,
				<GIC_SPI 699 IRQ_TYPE_EDGE_RISING>,
				<GIC_SPI 700 IRQ_TYPE_EDGE_RISING>,
				<GIC_SPI 701 IRQ_TYPE_LEVEL_HIGH>,
				<GIC_SPI 702 IRQ_TYPE_LEVEL_HIGH>,
				<GIC_SPI 851 IRQ_TYPE_EDGE_RISING>,
				<GIC_SPI 852 IRQ_TYPE_EDGE_RISING>;
		clocks =	<&cpg CPG_MOD R9A09G077_ADC_ADCLK>,
				<&cpg CPG_MOD R9A09G077_ADC_PCLK>;
		clock-names =	"adclk"," pclk";
		resets =	<&cpg R9A09G077_ADC_PRESETN>,
				<&cpg R9A09G077_ADC_ADRST_N>;
		reset-names =	"presetn", "adrst-n";
		power-domains = <&cpg>;

		pinctrl-0 = <&adc0_pins>;
		pinctrl-names = "default";

		#address-cells = <1>;
		#size-cells = <0>;

		chanel@0 {
			reg = <0>;
		};

		chanel@1 {
			reg = <1>;
		};
	};
```

## Documentation/devicetree/bindings/media/renesas,rzg2l-cru.txt
```
Renesas RZ/G2L Camera Receiving Unit driver (rzg2l-cru)
------------------------------------------------------

The rzg2l-cru device provides receiving data output from camera and
convert capabilities for the Renesas RZ/G2L family of devices.

CRU has 2 blocks: CSI2 receiver and image processing block. Image processing
block can receive video data from the external Digital Parallel Interface that
support YUV video with both external synchronization and BT.656
synchronization for the latter.

 - compatible: Must be one or more of the following
   - "renesas,cru-r9a07g044l" for the R9A07G044L device.
   - "renesas,cru-rzg2l" for the generic RZ/G2L device.
   - "renesas,cru-r9a07g043u" for the R9A07G043U (RZ/G2UL) device.
 - reg: the register base and size for the device registers
 - interrupts: the interrupt for the device
 - clocks: Reference to the parent clock
 - reset: Reference to the reset block.

The per-board settings:
RZ/G2L can only support a single connected parallel input source from external
SoC pins (port@0) or a parallel input source from local SoC CSI-2 receiver
(port@1) depending on SoC.

- ports
    - port@0 - sub-node describing a single endpoint connected to the CRU
      from external SoC pins as described in video-interfaces.txt[1].

    - port@1 - sub-nodes describing a single endpoint connected to the CRU
      from local SoC CSI-2 receiver.

Device node example
-------------------

	cru: video@10830000 {
		compatible = "renesas,cru-r9a07g044l", "renesas,cru-rzg2l";
		reg = <0 0x10830000 0 0x400>;
		clocks = <&cpg CPG_MOD R9A07G044L_CLK_CRU>;
		interrupts = <GIC_SPI 167 IRQ_TYPE_LEVEL_HIGH>;
		resets = <&cpg R9A07G044L_CLK_CRU>;
		power-domains = <&cpg>;
		status = "disabled";

		ports {
			#address-cells = <1>;
			#size-cells = <0>;

			port@0 {
				reg = <0>;

				cru_to_parallel: endpoint {
				};
			};

			port@1 {
				reg = <1>;

				cru_to_csi2: endpoint {
					remote-endpoint = <&csi2_to_cru>;
				};
			};
		};
	};

[1] video-interfaces.txt common video media interface
```

## Documentation/devicetree/bindings/media/renesas,rzg2l-csi2.txt
```
Renesas RZ/G2L MIPI CSI-2
------------------------

The RZ/G2L CSI-2 receiver device provides MIPI CSI-2 capabilities for the
Renesas RZ/G2L family of devices. It is used in conjunction with the
RZ/G2L CRU module, which provides the video capture capabilities.

Mandatory properties
--------------------
 - compatible: Must be one or more of the following
   - "renesas,r9a07g044l-csi2" for the R9A07G044L device.
   - "renesas,rzg2l-csi2" for the generic RZ/G2L device.

 - reg: the register base and size for the device registers
 - interrupts: the interrupt for the device
 - clocks: reference to the parent clock
 - resets: reference to the reset part.

The device node shall contain two 'port' child nodes according to the
bindings defined in Documentation/devicetree/bindings/media/
video-interfaces.txt. port@0 shall connect to the CSI-2 source. port@1
shall connect to all the RZ/G2L CRU module that have a hardware
connection to the CSI-2 receiver.

- port@0- Video source
        - endpoint@0 - sub-node describing the endpoint that is the video source

- port@1 - CRU instance
        - One endpoint sub-node for CRU which is connected
          to the RZ/G2L CSI-2 receiver.

Example:

	csi2: csi2@10830400 {
		compatible = "renesas,r9a07g044l-csi2", "renesas,rzg2l-csi2";
		reg = <0 0x10830400 0 0xc00>;
		interrupts = <GIC_SPI 166 IRQ_TYPE_LEVEL_HIGH>;
		clocks = <&cpg CPG_MOD R9A07G044L_CLK_CSI2>;
		resets = <&cpg R9A07G044L_CLK_CSI2>;
		power-domains = <&cpg>;
		status = "disabled";

		ports {
			#address-cells = <1>;
			#size-cells = <0>;

			port@1 {
				reg = <1>;

				csi2_to_cru: endpoint {
					remote-endpoint = <&cru_to_csi2>;
				};
			};
		};
	};
```
