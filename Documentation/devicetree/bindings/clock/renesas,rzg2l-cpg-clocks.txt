## Documentation/devicetree/bindings/pwm/renesas,gpt-rg2l.txt
```
* Renesas GPT Timer Controller

Required Properties:
- compatible: should be "renesas,pwm-rcar" and one of the following.
 - "renesas,rzg2l-gpt": for RZ/G2L
- reg: base address and length of the registers block for the PWM.
- #pwm-cells: should be 2. See pwm.txt in this directory for a description of
  the cells format.
- clocks: clock phandle and specifier pair.
- pinctrl-0: phandle, referring to a default pin configuration node.
- pinctrl-names: Set to "default".

Example: R9A07G044L (RZ/G2L) GPT(PWM) Timer node

                gpt0: gpt@10048000 {
                        compatible = "renesas,gpt-r9a07g044l";
                        reg = <0 0x10048000 0 0xa4>;
                        #pwm-cells = <2>;
                        clocks = <&cpg CPG_MOD R9A07G044L_CLK_GPT>;
                        status = "disabled";
                };
```

## Documentation/devicetree/bindings/pwm/renesas,poeg-rzg2l.txt
```
* Renesas Port Output Enable for GPT (POEG)

Required Properties:
- compatible: should be "renesas,poeg" and one of the following.
 - "renesas,poeg-r9a07g044l": for RZ/G2L
 - "renesas,poeg-r9a07g054l": for RZ/V2L
- reg: base address and length of the registers block for the POEG
- pinctrl-0: phandle, referring to a default pin configuration node.
- pinctrl-names: Set to "default".

Example: R9A07G044L (RZ/G2L) Port Output Enable for GPT (POEG)

                poega: poeg@10048800 {
                        compatible = "renesas,poeg-r9a07g044l";
                        reg = <0 0x10048800 0 0x04>;
                        interrupts = <GIC_SPI 322 IRQ_TYPE_LEVEL_HIGH>;
                        status = "disabled";
                };
```

## Documentation/devicetree/bindings/sound/renesas,rzg2l-ssi.txt
```
Renesas RZ/G2L SSI

Required properties:
- compatible			: "renesas,rzg2l-ssi",
- reg				: Should contain the register physical address and length
- interrupts			: Should contain SSI interrupt int, dma rx and dma tx

- clocks			: References to SSI/AUDIO_CLK clocks.
- clock-names			: List of necessary clock names.
				  "ssi", "audio_clk1", "audio_clk2"
- resets			: References to SSI resets.

Example:

	ssi0: ssi@10049c00 {
		#sound-dai-cells = <0>;
		compatible = "renesas,rzg2l-ssi";
		reg = <0 0x10049c00 0 0x00000028>;
		interrupts = <GIC_SPI 326 IRQ_TYPE_LEVEL_HIGH>,
			     <GIC_SPI 327 IRQ_TYPE_EDGE_RISING>,
			     <GIC_SPI 328 IRQ_TYPE_EDGE_RISING>;
		interrupt-names = "int", "rx", "tx";
		clocks = <&cpg CPG_MOD R9A07G044L_CLK_SSI0> ,
			 <&audio_clk1>,
			 <&audio_clk2>;
		clock-names = "ssi", "audio_clk1", "audio_clk2";
		resets = <&cpg R9A07G044L_CLK_SSI0>;
		power-domains = <&cpg>;
		status = "disabled";
	};
```

## Documentation/devicetree/bindings/thermal/rcar-gen3-thermal.txt
```
* DT bindings for Renesas R-Car Gen3 Thermal Sensor driver

On R-Car Gen3 SoCs, the thermal sensor controllers (TSC) control the thermal
sensors (THS) which are the analog circuits for measuring temperature (Tj)
inside the LSI.

Required properties:
- compatible		: "renesas,<soctype>-thermal",
			  Examples with soctypes are:
			    - "renesas,r8a774a1-thermal" (RZ/G2M v1.3)
			    - "renesas,r8a774a3-thermal" (RZ/G2M v3.0)
			    - "renesas,r8a774b1-thermal" (RZ/G2N)
			    - "renesas,r8a774e1-thermal" (RZ/G2H)
			    - "renesas,r8a7795-thermal" (R-Car H3)
			    - "renesas,r8a7796-thermal" (R-Car M3-W)
			    - "renesas,r8a77965-thermal" (R-Car M3-N)
- reg			: Address ranges of the thermal registers. Each sensor
			  needs one address range. Sorting must be done in
			  increasing order according to datasheet, i.e.
			  TSC1, TSC2, ...
- clocks		: Must contain a reference to the functional clock.
- #thermal-sensor-cells : must be <1>.

Optional properties:

- interrupts           : interrupts routed to the TSC (3 for H3, M3-W and M3-N)
- power-domain		: Must contain a reference to the power domain. This
			  property is mandatory if the thermal sensor instance
			  is part of a controllable power domain.

Example:

	tsc: thermal@e6198000 {
		compatible = "renesas,r8a7795-thermal";
		reg = <0 0xe6198000 0 0x100>,
		      <0 0xe61a0000 0 0x100>,
		      <0 0xe61a8000 0 0x100>;
		interrupts = <GIC_SPI 67 IRQ_TYPE_LEVEL_HIGH>,
			     <GIC_SPI 68 IRQ_TYPE_LEVEL_HIGH>,
			     <GIC_SPI 69 IRQ_TYPE_LEVEL_HIGH>;
		clocks = <&cpg CPG_MOD 522>;
		power-domains = <&sysc R8A7795_PD_ALWAYS_ON>;
		#thermal-sensor-cells = <1>;
	};

	thermal-zones {
		sensor_thermal1: sensor-thermal1 {
			polling-delay-passive = <250>;
			polling-delay = <1000>;
			thermal-sensors = <&tsc 0>;

			trips {
				sensor1_crit: sensor1-crit {
					temperature = <90000>;
					hysteresis = <2000>;
					type = "critical";
				};
			};
		};
	};

* Emergency shutdown for R-CAR Gen3 and RZ/G2
Emergency shutdown functionality provides the specific cooling mechanism
for R-CAR Gen3 and RZ/G2. In case of high temperature(e.g over 100 degrees),
it has the ability to rapidly cool down the system.

Required property:
- polling-delay:	The maximum number of milliseconds to wait between polls
  Type: unsigned	when checking temperature for emergency shutdown.
  Size: one cell

- on-temperature:       This value indicate the emergency temperature and
  Type: unsigned	invokes emergency shutdown functionality when exceeding
  Size: one cell	this temperature.

- off-temperature:	This value indicates the temperature to disable
  Type: unsigned	emergency shutdown.
  Size: one cell

- status:		Should be "disabled" always.
  Type: string

- target_cpus:		This property indicates which CPU will be targeted for
  Type: phandle		shutdown.

thermal-zones {
	emergency {
		polling-delay = <1000>;    /* milliseconds */
		on-temperature = <110000>; /* millicelsius */
		off-temperature = <95000>; /* millicelsius */
		target_cpus = <&a57_1>,
			      <&a57_2>,
			      <&a57_3>;
		status = "disabled";
	};
};
```

## drivers/hw_tim/Kconfig
```kconfig
menu "RZ/V2M TIM drivers"

config TIM_RZV2M
       bool "Timer for the RZ/V2M"
       help
         RZ/V2M TIM drivers enable.

endmenu
```

## drivers/pinctrl/rzv2m/Kconfig
```kconfig
config PINCTRL_RZV2M
	tristate "PFC for RZV2M"
	select GPIOLIB
	select GENERIC_IRQ_CHIP
	help
		Enable pin controller for RZ/V2M
```
