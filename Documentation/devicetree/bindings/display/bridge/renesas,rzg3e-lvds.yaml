## Documentation/devicetree/bindings/display/bridge/renesas,rzg3e-lvds.yaml
```yaml
# SPDX-License-Identifier: (GPL-2.0-only OR BSD-2-Clause)
%YAML 1.2
---
$id: http://devicetree.org/schemas/display/bridge/renesas,rzg3e-lvds.yaml#
$schema: http://devicetree.org/meta-schemas/core.yaml#

title: Renesas RZ/G3E LVDS Encoder

maintainers:
  - Biju Das <biju.das.jz@bp.renesas.com>
  - Tommaso Merciai <tommaso.merciai.xr@bp.renesas.com>

description: |
  These DT bindings describe the LVDS encoder embedded in the Renesas RZ/G3E
  SoCs. This has 2 channels and can be used in different modes depending on
  the use case.

  In particular, has 5 operating modes:

  Single-link(ch0 only):
    This mode outputs the image data of LCDC0 to LVDS (ch0).
    In this mode, LVDS (ch1) is not used.

  Single-link(ch1 only):
    This mode outputs the image data of LCDC1 to LVDS (ch1).
    In this mode, LVDS (ch0) is not used.

  Single-link(2ch):
    In this mode, the image data of LCDC0 is output to LVDS (ch0) and the
    image data of LCDC1 is output to LVDS (ch1).
    Since LVDS (ch0) and LVDS (ch1) are not synchronously related, they
    can be output in different image formats and can be operated
    asynchronously.

  Single-link(Multi)
    In this mode, the image data of LCDC0 is output to both LVDS (ch0) and
    LVDS (ch1). LVDS (ch0) and LVDS (ch1) operate synchronously.

  Dual-link:
    In this mode, the input image data of LCDC0 is separated into Even pixels
    and Odd pixels, and the output is distributed to LVDS ch0 and ch1.

properties:
  compatible:
    const: renesas,r9a09g047-lvds

  reg:
    maxItems: 1

  clocks:
    items:
      - description: Peripheral clock
      - description: PHY clock
      - description: Dot clock

  clock-names:
    items:
      - const: pclk
      - const: phyclk
      - const: dotclk

  resets:
    maxItems: 1

  power-domains:
    maxItems: 1

  renesas,id:
    $ref: /schemas/types.yaml#/definitions/uint32
    enum: [0, 1]
    description:
      LVDS encoder channel number.

  ports:
    $ref: /schemas/graph.yaml#/properties/ports

    properties:
      port@0:
        $ref: /schemas/graph.yaml#/properties/port
        description: Input channel, directly connected to the Display Unit.

      port@1:
        $ref: /schemas/graph.yaml#/properties/port
        description: |
          Output channel, directly connected to the LVDS panel or bridge.

    required:
      - port@0
      - port@1

  renesas,companion:
    $ref: /schemas/types.yaml#/definitions/phandle
    description:
      phandle to the companion LVDS encoder for dual-link operation. This
      property shall only be set for the primary LVDS encoder when dual-link
      mode is required. The companion encoder shall not have this property set.

required:
  - compatible
  - reg
  - clocks
  - clock-names
  - resets
  - power-domains
  - renesas,id
  - ports

additionalProperties: false

examples:
  - |
    #include <dt-bindings/clock/renesas,r9a09g047-cpg.h>

    lvds-cmn@164c0000 {
        compatible = "simple-mfd", "syscon";
        reg = <0x164c0000 0x10000>;
        #address-cells = <1>;
        #size-cells = <1>;

        lvds0: lvds0-encoder@10 {
            compatible = "renesas,r9a09g047-lvds";
            reg = <0x10 0x8>;
            clocks = <&cpg CPG_MOD 0x1a4>,
                     <&cpg CPG_MOD 0x1a0>,
                     <&cpg CPG_MOD 0x1a2>;
            clock-names = "pclk", "phyclk", "dotclk";
            resets = <&cpg 0x11a>;
            power-domains = <&cpg>;
            renesas,id = <0>;

            ports {
                #address-cells = <1>;
                #size-cells = <0>;

                port@0 {
                    reg = <0>;
                    lvds0_in: endpoint {
                        remote-endpoint = <&du_out_lvds0>;
                    };
                };

                port@1 {
                    reg = <1>;
                    lvds0_out: endpoint {
                        remote-endpoint = <&panel_in>;
                    };
                };
            };
        };

        lvds1: lvds1-encoder@18 {
            compatible = "renesas,r9a09g047-lvds";
            reg = <0x18 0x8>;
            clocks = <&cpg CPG_MOD 0x1a4>,
                     <&cpg CPG_MOD 0x1a1>,
                     <&cpg CPG_MOD 0x1a3>;
            clock-names = "pclk", "phyclk", "dotclk";
            resets = <&cpg 0x11a>;
            power-domains = <&cpg>;
            renesas,id = <1>;

            ports {
                #address-cells = <1>;
                #size-cells = <0>;

                port@0 {
                    reg = <0>;
                    lvds1_in: endpoint {
                        remote-endpoint = <&du_out_lvds1>;
                    };
                };

                port@1 {
                    reg = <1>;
                    lvds1_out: endpoint {
                        remote-endpoint = <&panel_in>;
                    };
                };
            };
        };
    };

...
```

## Documentation/devicetree/bindings/edac/renesas,rzg2l-edac.yaml
```yaml
# SPDX-License-Identifier: GPL-2.0-only OR BSD-2-Clause
%YAML 1.2
---
$id: http://devicetree.org/schemas/edac/renesas,rzg2l-edac.yaml#
$schema: http://devicetree.org/meta-schemas/core.yaml#

title: Renesas Memory Controller EDAC

maintainers:
  - Hung Tran <hung.tran.jy@renesas.com>

description: |
  EDAC node is defined to describe error detection and correction for
  Renesas Memory Controller.

properties:

  compatible:
    enum:
      - renesas,r9a07g043-edac
      - renesas,r9a07g043f-edac
      - renesas,r9a07g044-edac
      - renesas,r9a07g054-edac
      - renesas,r9a07g076-edac

  reg:
    maxItems: 1

  interrupts:
    maxItems: 1

  interrupt-names:
    maxItems: 1

required:
  - compatible
  - reg
  - interrupts
  - interrupt-names

additionalProperties: false

examples:
  - |
    #include <dt-bindings/interrupt-controller/arm-gic.h>

    edac: edac@80300000 {
        compatible = "renesas,r9a07g076-edac";
        reg = <0 0x80300000 0 0x10000>;
        interrupts = <GIC_SPI 629 IRQ_TYPE_LEVEL_HIGH>;
        interrupt-names = "ecc_irq";
    };
```

## Documentation/devicetree/bindings/i2c/renesas,i2c-rsci.yaml
```yaml
# SPDX-License-Identifier: (GPL-2.0-only OR BSD-2-Clause)
%YAML 1.2
---
$id: http://devicetree.org/schemas/i2c/renesas,i2c-rsci.yaml#
$schema: http://devicetree.org/meta-schemas/core.yaml#

title: Renesas Serial Communication Interface (RSCI) I2C Master Controller

allOf:
  - $ref: /schemas/i2c/i2c-controller.yaml#

properties:
  compatible:
    oneOf:
      - items:
          - enum:
              - renesas,r9a08g046-rz-rsci # RZ/G3L
              - renesas,rz-rsci-i2c    # RSCI I2C mode

  reg:
    maxItems: 1

  interrupts:
    items:
        - description: Error Interrupt
        - description: Reception End Interrupt
        - description: Transmit End Interrupt
        - description: Completion Of Generation Of
                       A Start, Restart, Or Stop Condition (STI) Interrupt

  interrupt-names:
    items:
        - const: eri
        - const: rxi
        - const: txi
        - const: tei

  clock-frequency:
    description:
      Desired I2C bus clock frequency in Hz. The absence of this property
      indicates the default frequency 100 kHz.

  clocks:
    maxItems: 2

  clock-names:
    items:
      - const: fck
      - const: tclk

  resets:
    maxItems: 2

  reset-names:
    items:
      - const: presetn
      - const: tresetn

  power-domains:
    maxItems: 1

  status:
    maxItems: 1

if:
  properties:
    status:
      const: "okay"
then:
  properties:
    compatible:
        contains:
            const: renesas,rz-rsci-i2c

required:
  - compatible
  - reg
  - interrupts
  - interrupt-names
  - clocks
  - clock-names
  - resets
  - reset-names
  - power-domains
  - clock-frequency
  - status

unevaluatedProperties: false

examples:
  - |
    #include <dt-bindings/interrupt-controller/arm-gic.h>
    #include <dt-bindings/clock/r9a08g046-cpg.h>
    rsci: i2c@100f1000 {
        compatible = "renesas,r9a08g046-rz-rsci", "renesas,rz-rsci-i2c";
        reg = <0 0x100f1000 0 0x1000>;
        interrupts = <GIC_SPI 422 IRQ_TYPE_LEVEL_HIGH>,
                    <GIC_SPI 423 IRQ_TYPE_EDGE_RISING>,
                    <GIC_SPI 424 IRQ_TYPE_EDGE_RISING>,
                    <GIC_SPI 425 IRQ_TYPE_LEVEL_HIGH>;
        interrupt-names = "eri", "rxi", "txi", "tei";
        clocks = <&cpg CPG_MOD R9A08G046_RSCI1_PCLK>,
            <&cpg CPG_MOD R9A08G046_RSCI1_TCLK>;
        clock-names = "fck", "tclk";
        power-domains = <&cpg>;
        resets = <&cpg R9A08G046_RSCI1_PRESETN>,
            <&cpg R9A08G046_RSCI1_TRESETN>;
        reset-names = "presetn", "tresetn";
        clock-frequency = <100000>;
        status = "disabled";
    };
```

## Documentation/devicetree/bindings/iio/adc/renesas,r9a07g076-adc.yaml
```yaml
# SPDX-License-Identifier: (GPL-2.0-only OR BSD-2-Clause)
%YAML 1.2
---
$id: http://devicetree.org/schemas/iio/adc/renesas,r9a07g076-adc.yaml#
$schema: http://devicetree.org/meta-schemas/core.yaml#

title: Renesas RZ/T2N ADC12

maintainers:
  - Cosmin Tanislav <cosmin-gabriel.tanislav.xa@renesas.com>

description: |
  A/D Converter block is a successive approximation analog-to-digital converter
  with a 12-bit accuracy. Up to 15 analog input channels can be selected.
  Conversions can be performed in single or continuous mode. Result of the ADC
  is stored in a 16-bit data register corresponding to each channel.

properties:
  compatible:
    enum:
      - renesas,r9a07g076-adc # RZ/T2N

  reg:
    maxItems: 1

  interrupts:
    items:
      - description: A/D scan end interrupt
      - description: A/D scan end interrupt for Group B
      - description: A/D scan end interrupt for Group C
      - description: Window A compare match
      - description: Window B compare match
      - description: Compare match
      - description: Compare mismatch

  interrupt-names:
    items:
      - const: adi
      - const: gbadi
      - const: gcadi
      - const: cmpai
      - const: cmpbi
      - const: wcmpm
      - const: wcmpum

  clocks:
    items:
      - description: converter clock
      - description: peripheral clock

  clock-names:
    items:
      - const: adclk
      - const: pclk

  power-domains:
    maxItems: 1

  renesas,max-channels:
    $ref: /schemas/types.yaml#/definitions/uint32
    description: |
      Maximum number of channels supported by the ADC.
      RZ/T2H has two ADCs with 4 channels and one with 8 channels.

  '#address-cells':
    const: 1

  '#size-cells':
    const: 0

  "#io-channel-cells":
    const: 1

required:
  - compatible
  - reg
  - interrupts
  - clocks
  - clock-names
  - power-domains
  - renesas,max-channels

patternProperties:
  "^channel@[0-9a-e]$":
    $ref: adc.yaml
    type: object
    description: The external channels which are connected to the ADC.

    properties:
      reg:
        description: The channel number.
        maximum: 16

    required:
      - reg

    additionalProperties: false

allOf:
  - if:
      properties:
        compatible:
          contains:
            const: renesas,r9a07g076-adc
    then:
      properties:
        renesas,max-channels:
          enum: [4, 8]

      patternProperties:
        "^channel@[6-9a-e]$": false
        "^channel@[0-5]$":
          properties:
            reg:
              maximum: 5

additionalProperties: false

examples:
  - |
    #include <dt-bindings/clock/renesas,r9a07g076-cpg.h>
    #include <dt-bindings/interrupt-controller/arm-gic.h>

    adc0: adc0@90014000 {
      compatible = "renesas,r9a07g076-adc";
      reg = <0x80008000 0x400>;
      interrupts = <GIC_SPI 553 IRQ_TYPE_EDGE_RISING>,
                   <GIC_SPI 554 IRQ_TYPE_EDGE_RISING>,
                   <GIC_SPI 555 IRQ_TYPE_EDGE_RISING>,
                   <GIC_SPI 556 IRQ_TYPE_LEVEL_HIGH>,
                   <GIC_SPI 557 IRQ_TYPE_LEVEL_HIGH>,
                   <GIC_SPI 661 IRQ_TYPE_EDGE_RISING>,
                   <GIC_SPI 662 IRQ_TYPE_EDGE_RISING>;
      interrupt-names = "adi", "gbadi", "gcadi",
                        "cmpai", "cmpbi", "wcmpm", "wcmpum";
      clocks = <&cpg CPG_MOD R9A07G076_ADC0_CLK>;
      power-domains = <&cpg>;
      #address-cells = <1>;
      #size-cells = <0>;
      #io-channel-cells = <1>;
      renesas,max-channels = <4>;

      channel@0 {
        reg = <0x0>;
      };
      channel@1 {
        reg = <0x1>;
      };
      channel@2 {
        reg = <0x2>;
      };
      channel@3 {
        reg = <0x3>;
      };
    };
```

## Documentation/devicetree/bindings/mtd/renesas-nandc-rzt2n.yaml
```yaml
# SPDX-License-Identifier: (GPL-2.0-only OR BSD-2-Clause)
%YAML 1.2
---
$id: http://devicetree.org/schemas/mtd/renesas-nandc.yaml#
$schema: http://devicetree.org/meta-schemas/core.yaml#

title: Renesas RZ/T2N NAND controller

maintainers:
  - Hung Tran <hung.tran.jy@renesas.com>

allOf:
  - $ref: nand-controller.yaml

properties:
  compatible:
    const: renesas,r9a07g076-nandc # RZ/T2N

  reg:
    maxItems: 3

  interrupts:
    maxItems: 1

  clocks:
    maxItems: 3

  clock-names:
    items:
      - const: nf_clk
      - const: sysclk
      - const: busclk

  resets:
    maxItems: 3

  reset-names:
    items:
      - const: rst_sys
      - const: rst_slave
      - const: rst_prot

  power-domains:
    maxItems: 1

  timing-mode:
    $ref: /schemas/types.yaml#/definitions/uint32
    description: |
      NAND timing mode index used by the controller driver.
      Valid values are 0..5. If omitted, the driver uses the default mode.
    minimum: 0
    maximum: 5

required:
  - compatible
  - reg
  - interrupts
  - clocks
  - clock-names
  - resets
  - reset-names
  - power-domains
  - '#address-cells'
  - '#size-cells'

unevaluatedProperties: false

examples:
  - |
    #include <dt-bindings/interrupt-controller/arm-gic.h>
    #include <dt-bindings/clock/r9a06g032-sysctrl.h>

    nandc: nandc@92050000 {
        compatible = "renesas,r9a07g076-nandc";
        reg = <0 0x92050000 0 0x4000>,
              <0 0x10100000 0 0x100000>,
              <0 0x80297000 0 0x50>;
        interrupts = <GIC_SPI 628 IRQ_TYPE_LEVEL_HIGH>;
        clocks = <&cpg CPG_MOD R9A07G076_NANDC_CLK>,
                 <&cpg CPG_CORE R9A07G076_PCLKAM>,
                 <&cpg CPG_CORE R9A07G076_PCLKAL>;
        clock-names = "nf_clk", "sysclk", "busclk";
        resets = <&cpg R9A07G076_NANDC_SYSTEM_RST>,
                 <&cpg R9A07G076_NANDC_SLAVE_RST>,
                 <&cpg R9A07G076_NANDC_PROTECT_RST>;
        reset-names = "rst_sys", "rst_slave", "rst_prot";
        power-domains = <&cpg>;
        #address-cells = <1>;
        #size-cells = <0>;
        status = "disabled";
    };

    &nandc {
        pinctrl-0 = <&nandc_pins>;
        pinctrl-names = "default";

        status = "okay";

        nand@0 {
            reg = <0>;
            label = "nand0";
            timing-mode = <3>;

            partitions {
                compatible = "fixed-partitions";
                #address-cells = <1>;
                #size-cells = <2>;

                partition@0 {
                    label = "nand-partition";
                    reg = <0x00000000 0x1 0x00000000>;
                };
            };
        };
    };
```
