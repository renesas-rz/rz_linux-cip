## Documentation/devicetree/bindings/net/dsa/renesas,rzn1-a5psw.yaml
```yaml
# SPDX-License-Identifier: (GPL-2.0-only OR BSD-2-Clause)
%YAML 1.2
---
$id: http://devicetree.org/schemas/net/dsa/renesas,rzn1-a5psw.yaml#
$schema: http://devicetree.org/meta-schemas/core.yaml#

title: Renesas RZ/N1 A5PSW and RZ/T2H, RZ/N2H ETHSW Ethernet Switch

maintainers:
  - Clément Léger <clement.leger@bootlin.com>
  - Lad Prabhakar <prabhakar.mahadev-lad.rj@bp.renesas.com>

description: >
  This binding describes the Ethernet switch IPs used on Renesas SoCs:

  - The A5PSW (Advanced 5-Port Switch) found on the RZ/N1 family, which
    provides 4 external ports and 1 CPU/management port.
  - The ETHSW (Ethernet Switch) found on the RZ/T2H and RZ/N2H families,
    which is derived from the A5PSW IP with some register layout
    differences, additional timestamping support, and a total of 4 ports
    including the CPU/management port.

properties:
  compatible:
    oneOf:
      - items:
          - enum:
              - renesas,r9a06g032-a5psw
          - const: renesas,rzn1-a5psw

      - const: renesas,r9a09g077-ethsw

      - items:
          - const: renesas,r9a09g087-ethsw
          - const: renesas,r9a09g077-ethsw

  reg:
    maxItems: 1

  interrupts:
    oneOf:
      - items:
          - description: Device Level Ring (DLR) interrupt
          - description: Switch interrupt
          - description: Parallel Redundancy Protocol (PRP) interrupt
          - description: Integrated HUB module interrupt
          - description: Receive Pattern Match interrupt

      - items:
          - description: Switch interrupt
          - description: Device Level Ring (DLR) interrupt
          - description: Parallel Redundancy Protocol (PRP) interrupt
          - description: Integrated HUB module interrupt
          - description: Receive Pattern Match interrupt 0
          - description: Receive Pattern Match interrupt 1
          - description: Receive Pattern Match interrupt 2
          - description: Receive Pattern Match interrupt 3
          - description: Receive Pattern Match interrupt 4
          - description: Receive Pattern Match interrupt 5
          - description: Receive Pattern Match interrupt 6
          - description: Receive Pattern Match interrupt 7
          - description: Receive Pattern Match interrupt 8
          - description: Receive Pattern Match interrupt 9
          - description: Receive Pattern Match interrupt 10
          - description: Receive Pattern Match interrupt 11
          - description: Switch timer pulse output interrupt 0
          - description: Switch timer pulse output interrupt 1
          - description: Switch timer pulse output interrupt 2
          - description: Switch timer pulse output interrupt 3
          - description: Switch TDMA timer output interrupt 0
          - description: Switch TDMA timer output interrupt 1
          - description: Switch TDMA timer output interrupt 2
          - description: Switch TDMA timer output interrupt 3

  interrupt-names:
    oneOf:
      - items:
          - const: dlr
          - const: switch
          - const: prp
          - const: hub
          - const: ptrn

      - items:
          - const: switch
          - const: dlr
          - const: prp
          - const: hub
          - const: ptrn0
          - const: ptrn1
          - const: ptrn2
          - const: ptrn3
          - const: ptrn4
          - const: ptrn5
          - const: ptrn6
          - const: ptrn7
          - const: ptrn8
          - const: ptrn9
          - const: ptrn10
          - const: ptrn11
          - const: tp0
          - const: tp1
          - const: tp2
          - const: tp3
          - const: tdma0
          - const: tdma1
          - const: tdma2
          - const: tdma3

  power-domains:
    maxItems: 1

  mdio:
    $ref: /schemas/net/mdio.yaml#
    unevaluatedProperties: false

  clocks:
    minItems: 2
    items:
      - description: AHB clock used for the switch register interface
      - description: Switch system clock
      - description: Timestamp clock

  clock-names:
    minItems: 2
    items:
      - const: hclk
      - const: clk
      - const: ts

  resets:
    maxItems: 1

  ethernet-ports:
    type: object
    additionalProperties: true
    patternProperties:
      "^(ethernet-)?port@[0-4]$":
        type: object
        additionalProperties: true
        properties:
          pcs-handle:
            maxItems: 1
            description:
              phandle pointing to a PCS sub-node compatible with
              renesas,rzn1-miic.yaml#

required:
  - compatible
  - reg
  - clocks
  - clock-names
  - power-domains
  - interrupts
  - interrupt-names

allOf:
  - $ref: dsa.yaml#/$defs/ethernet-ports

  - if:
      properties:
        compatible:
          contains:
            const: renesas,r9a09g077-ethsw
    then:
      properties:
        interrupts:
          minItems: 24
        interrupt-names:
          minItems: 24
        clocks:
          minItems: 3
        clock-names:
          minItems: 3
      required:
        - resets
    else:
      properties:
        interrupts:
          maxItems: 5
        interrupt-names:
          maxItems: 5
        clocks:
          maxItems: 2
        clock-names:
          maxItems: 2
        resets: false

unevaluatedProperties: false

examples:
  - |
    #include <dt-bindings/gpio/gpio.h>
    #include <dt-bindings/clock/r9a06g032-sysctrl.h>
    #include <dt-bindings/interrupt-controller/arm-gic.h>

    switch@44050000 {
        compatible = "renesas,r9a06g032-a5psw", "renesas,rzn1-a5psw";
        reg = <0x44050000 0x10000>;
        clocks = <&sysctrl R9A06G032_HCLK_SWITCH>, <&sysctrl R9A06G032_CLK_SWITCH>;
        clock-names = "hclk", "clk";
        power-domains = <&sysctrl>;
        interrupts = <GIC_SPI 40 IRQ_TYPE_LEVEL_HIGH>,
                     <GIC_SPI 42 IRQ_TYPE_LEVEL_HIGH>,
                     <GIC_SPI 43 IRQ_TYPE_LEVEL_HIGH>,
                     <GIC_SPI 44 IRQ_TYPE_LEVEL_HIGH>,
                     <GIC_SPI 45 IRQ_TYPE_LEVEL_HIGH>;
        interrupt-names = "dlr", "switch", "prp", "hub", "ptrn";

        dsa,member = <0 0>;

        ethernet-ports {
            #address-cells = <1>;
            #size-cells = <0>;

            port@0 {
                reg = <0>;
                label = "lan0";
                phy-handle = <&switch0phy3>;
                pcs-handle = <&mii_conv4>;
            };

            port@1 {
                reg = <1>;
                label = "lan1";
                phy-handle = <&switch0phy1>;
                pcs-handle = <&mii_conv3>;
            };

            port@4 {
                reg = <4>;
                ethernet = <&gmac2>;
                phy-mode = "internal";

                fixed-link {
                  speed = <1000>;
                  full-duplex;
                };
            };
        };

        mdio {
            #address-cells = <1>;
            #size-cells = <0>;

            reset-gpios = <&gpio0a 2 GPIO_ACTIVE_HIGH>;
            reset-delay-us = <15>;
            clock-frequency = <2500000>;

            switch0phy1: ethernet-phy@1{
                reg = <1>;
            };

            switch0phy3: ethernet-phy@3{
                reg = <3>;
            };
        };
    };
```

## Documentation/devicetree/bindings/net/ethercat/renesas,rzt2h-esc.yaml
```yaml
# SPDX-License-Identifier: (GPL-2.0-only OR BSD-2-Clause)
%YAML 1.2
---
$schema: http://devicetree.org/meta-schemas/core.yaml#

title: Renesas RZ/T2H Ethercat Slave Controller

description: |
  The Ethercat Slave Controller is present on the Renesas RZ/T2H SoC
  family and handles 3 ports.

allOf:
  - $ref: dsa.yaml#/$defs/ethernet-ports

properties:
  compatible:
    items:
      - enum:
          - renesas,rzt2h-esc
          - renesas,rzn2h-esc

  reg:
    maxItems: 1

  interrupts:
    items:
      - description: EtherCAT Sync0 interrupt
      - description: EtherCAT Sync1 interrupt
      - description: EtherCAT interrupt

  interrupt-names:
    items:
      - const: sync0irq
      - const: sync1irq
      - const: catirq

  power-domains:
    maxItems: 1

  mdio:
    $ref: /schemas/net/mdio.yaml#
    unevaluatedProperties: false

  clocks:
    items:
      - description: ESC system clock

  ethernet-ports:
    type: object
    properties:
      '#address-cells':
        const: 1
      '#size-cells':
        const: 0

    patternProperties:
      "^(ethernet-)?port@[0-2]$":
        type: object
        description: ESC ports

        properties:
          pcs-handle:
            maxItems: 1
            description:
              phandle pointing to a PCS sub-node compatible with
              renesas,rzt2h-ethss.yaml#

unevaluatedProperties: false

required:
  - compatible
  - reg
  - clocks
  - power-domains

examples:
  - |

	esc: esc@80130000 {
		compatible = "renesas,rzt2h-esc";
		reg =  <0 0x80130000 0 0x10000>;
		interrupts = <GIC_SPI 579 IRQ_TYPE_EDGE_RISING>,
			     <GIC_SPI 580 IRQ_TYPE_EDGE_RISING>,
			     <GIC_SPI 581 IRQ_TYPE_LEVEL_HIGH>;
		interrupt-names = "sync0irq", "sync1irq", "catirq";
		clocks = <&cpg CPG_MOD R9A09G077_ESC_CLK>;
		resets = <&cpg R9A09G077_ESC_BUS_RST>,
			 <&cpg R9A09G077_ESC_IP_RST>;
		reset-names = "reset_bus", "reset_ip";
		power-domains = <&cpg>;
		eeprom-size = <0>;
		phy-address-offset = <0>;
		txc-port-delay = <0>;
		status = "disabled";

		ethernet-ports {
			#address-cells = <1>;
			#size-cells = <0>;

			esc_port0: port@0 {
				reg = <0>;
				pcs-handle = <&mii_conv0>;
				status = "disabled";
			};

			esc_port1: port@1 {
				reg = <1>;
				pcs-handle = <&mii_conv1>;
				status = "disabled";
			};

			esc_port2: port@2 {
				reg = <2>;
				pcs-handle = <&mii_conv2>;
				status = "disabled";
			};
		};

		mdio {
			#address-cells = <1>;
			#size-cells = <0>;

			phy0: ethernet-phy@0 {
				compatible = "ethernet-phy-id0007.0772";
				phy-mode = "rgmii-id";
				vsc8531,led-1-mode = <VSC8531_FORCE_LED_ON>;
				max-speed = <100>;
				reg = <0>;
			};

			phy1: ethernet-phy@1 {
				compatible = "ethernet-phy-id0007.0772";
				phy-mode = "rgmii-id";
				vsc8531,led-1-mode = <VSC8531_FORCE_LED_ON>;
				max-speed = <100>;
				reg = <1>;
			};

			phy2: ethernet-phy@2 {
				compatible = "ethernet-phy-id0007.0772";
				phy-mode = "rgmii-id";
				vsc8531,led-1-mode = <VSC8531_FORCE_LED_ON>;
				max-speed = <100>;
				reg = <2>;
			};
		};
	};
```

## Documentation/devicetree/bindings/net/renesas,rzt2-ethss.yaml
```yaml
# SPDX-License-Identifier: (GPL-2.0-only OR BSD-2-Clause)
%YAML 1.2
---
$id: http://devicetree.org/schemas/net/renesas,rzt2-ethss.yaml#
$schema: http://devicetree.org/meta-schemas/core.yaml#

title: Renesas RZ/T2N Ethernet Subsystem

description: |
  This Ethernet Subsystem is present on the Renesas RZ/T2N SoC family. It is
  responsible to do MII passthrough or convert it to RMII/RGMII.

properties:
  '#address-cells':
    const: 1

  '#size-cells':
    const: 0

  compatible:
    items:
      - const: renesas,rzt2-ethss

  reg:
    maxItems: 1

  clocks:
    items:
      - description: Clock used for the MII converter register interface

  renesas,ethss-switch-portmanagement:
    description: ETHSS Switch Management port configuration. This value should use one of
      the values defined in dt-bindings/net/rzt2-ethss.h.
    $ref: /schemas/types.yaml#/definitions/uint32

  power-domains:
    maxItems: 1

patternProperties:
  "^mii-conv@[0-5]$":
    type: object
    description: MII converter port

    properties:
      reg:
        description: MII Converter port number.
        enum: [0, 1, 2, 3, 4]

      renesas,ethss-port:
        description: Converter input port configuration. This value should use
          one of the values defined in dt-bindings/net/rzt2-ethss.h.
        $ref: /schemas/types.yaml#/definitions/uint32

    required:
      - reg
      - renesas,ethss-port

    additionalProperties: false

required:
  - '#address-cells'
  - '#size-cells'
  - compatible
  - reg
  - clocks
  - power-domains

additionalProperties: false

examples:
  - |
    #include <dt-bindings/net/rzt2-ethss.h>

	ethss: ethss@80110000 {
	        compatible = "renesas,rzt2-ethss";
	        #address-cells = <1>;
	        #size-cells = <0>;
	        reg =  <0 0x80110000 0 0x10000>;
	        clocks = <&cpg CPG_MOD R9A07G076_ETHSS_CLK>;
	        resets = <&cpg R9A07G076_ETHSS_RST>,
	                 <&cpg R9A07G076_MII_RST>;
	        reset-names = "reset_ethss", "reset_conv";
	        power-domains = <&cpg>;
	        status = "disabled";

	        mii_conv0: mii-conv@0 {
	                reg = <0>;
	                status = "disabled";
	        };

	        mii_conv1: mii-conv@1 {
	                reg = <1>;
	                status = "disabled";
	        };

	        mii_conv2: mii-conv@2 {
	                reg = <2>;
	                status = "disabled";
	        };

	        mii_conv3: mii-conv@3 {
	                reg = <3>;
	                status = "disabled";
	        };

	        mii_conv4: mii-conv@4 {
	                reg = <4>;
	                status = "disabled";
	        };
	};
```

## Documentation/devicetree/bindings/net/renesas,rzt2n-hpsw.yaml
```yaml
# SPDX-License-Identifier: (GPL-2.0-only OR BSD-2-Clause)
%YAML 1.2
---
$schema: http://devicetree.org/meta-schemas/core.yaml#

title: Renesas RZ/T2N HSR/PRP Switch

maintainers:
  - Nhat Nguyen <nhat.nguyen.xb@renesas.com>

properties:
  compatible:
    const: renesas,rzt2n-hpsw

  reg:
    maxItems: 1

  clocks:
    maxItems: 1

  resets:
    maxItems: 1

  power-domains:
    maxItems: 1

  ethernet-ports:
    type: object
    properties:
      '#address-cells':
        const: 1
      '#size-cells':
        const: 0

    patternProperties:
      "^(ethernet-)?port@[0-2]$":
        type: object
        description: Port number of HSR/PRP switch (HPSW).

        properties:
          pcs-handle:
            maxItems: 1
            description:
              phandle pointing to a PCS sub-node compatible with
              renesas,rzt2-ethss.yaml#

unevaluatedProperties: false

required:
  - compatible
  - reg
  - clocks
  - resets
  - power-domains

examples:
  - |
    #include <dt-bindings/interrupt-controller/arm-gic.h>
    #include <dt-bindings/clock/renesas,r9a07g076-cpg.h>

    hpsw: hpsw@80170000 {
       compatible = "renesas,rzt2n-hpsw";
       reg = <0 0x80170000 0 0x50000>;
       clocks = <&cpg CPG_MOD R9A07G076_HPSW_CLK>;
       resets = <&cpg R9A07G076_HPSW_RST>;
       power-domains = <&cpg>;
       status = "disabled";

       ethernet-ports {
               #address-cells = <1>;
               #size-cells = <0>;

               hpsw_portA: port@0 {
                     reg = <0>;
                     pcs-handle = <&mii_conv0>;
                     phy-mode = "rgmii-id";
                     phy-handle = <&phy0>;
                     status = "okay";
               };

               hpsw_portB: port@1 {
                     reg = <1>;
                     pcs-handle = <&mii_conv1>;
                     phy-mode = "rgmii-id";
                     phy-handle = <&phy1>;
                     status = "okay";
               };

               hpsw_portC: port@2 {
                     reg = <2>;
                     ethernet = <&gmac0>;
                     label = "cpu";
                     phy-mode = "internal";
                     status = "okay";
                     fixed-link {
                             speed = <1000>;
                             full-duplex;
                     };
               };
         };
    };
```
