## Documentation/devicetree/bindings/pwm/poeg-rzt2.txt
```
* Renesas RZ/T2 Port Output Enable for GPT (POEG)

Required Properties:
- compatible: Must be "renesas,poeg-rzt2"

- reg: Base address and length of the registers block for the POEG.
- interrupts: IRQ line for POEG.
- clocks:      References to all the clocks specified in the clock-names
               property as specified in
               Documentation/devicetree/bindings/clock/clock-bindings.txt.
- clock-names: Name of clock.
- power-domains: Must contain a reference to the PM domain, if available.
- pinctrl-0: phandle, referring to a default pin configuration node.
- pinctrl-names: Set to "default".

Example: R9A07G076 (RZ/T2N) Port Output Enable for GPT (POEG)

       poeg0_a: poega@90019000 {
               compatible = "renesas,poeg-r9a07g076";
               reg = <0 0x90019000 0 0x400>;
               interrupts = <GIC_SPI 337 IRQ_TYPE_LEVEL_HIGH>;
               clocks = <&cpg CPG_CORE R9A07G076_PCLKH>;
               power-domains = <&cpg>;
               llpp,disable-by-DSMIF-error;
               status = "disabled";
       };
```

## Documentation/devicetree/bindings/serial/renesas,rz-rsci.yaml
```yaml
# SPDX-License-Identifier: (GPL-2.0-only OR BSD-2-Clause)
%YAML 1.2
---
$id: http://devicetree.org/schemas/serial/renesas,rz-rsci.yaml#
$schema: http://devicetree.org/meta-schemas/core.yaml#

title: Renesas Serial Communication Interface (RSCI)

allOf:
  - $ref: serial.yaml#

properties:
  compatible:
    contains:
        enum:
            - renesas,r9a08g046-rz-rsci # RZ/G3L
            - renesas,rz-rsci           # RSCI UART mode 
            - renesas,rz-rscif          # RSCI UART mode with FIFO

  reg:
    maxItems: 1

  interrupts:
    oneOf:
      - items:
          - description: Error Interrupt
          - description: Receive Data Full Interrupt
          - description: Transmit Data Empty Interrupt
          - description: Transmit End Interrupt

  interrupt-names:
    oneOf:
      - items:
          - const: eri
          - const: rxi
          - const: txi
          - const: tei

  clocks:
    maxItems: 2

  clock-names:
    items:
      - const: fck
      - const: tclk

  resets:
    maxItems: 2

  reset-names:
    items:
      - const: presetn
      - const: tresetn

  dmas:
    maxItems: 2

  dma-names:
    items:
      - const: tx
      - const: rx

  power-domains:
    maxItems: 1

  num-cs:
    maxItems: 1

  status:
    maxItems: 1

  uart-has-rtscts: true

if:
  properties:
    status:
      const: "okay"
then:
  properties:
    compatible:
        contains:
            enum:
                - renesas,rz-rsci
                - renesas,rz-rscif

required:
  - compatible
  - reg
  - interrupts
  - interrupt-names
  - clocks
  - clock-names
  - resets
  - reset-names
  - dmas
  - dma-names
  - power-domains
  - status

unevaluatedProperties: false

examples:
  - |
    #include <dt-bindings/interrupt-controller/arm-gic.h>
    #include <dt-bindings/clock/r9a08g046-cpg.h>
    rsci: spi@100f1000 {
        compatible = "renesas,r9a08g046-rz-rsci", "renesas,rz-rsci";
        reg = <0 0x100f1000 0 0x1000>;
        interrupts = <GIC_SPI 422 IRQ_TYPE_LEVEL_HIGH>,
                    <GIC_SPI 423 IRQ_TYPE_EDGE_RISING>,
                    <GIC_SPI 424 IRQ_TYPE_EDGE_RISING>,
                    <GIC_SPI 425 IRQ_TYPE_LEVEL_HIGH>;
        interrupt-names = "eri", "rxi", "txi", "tei";
        clocks = <&cpg CPG_MOD R9A08G046_RSCI1_PCLK>,
            <&cpg CPG_MOD R9A08G046_RSCI1_TCLK>;
        clock-names = "fck", "tclk";
        power-domains = <&cpg>;
        resets = <&cpg R9A08G046_RSCI1_PRESETN>,
            <&cpg R9A08G046_RSCI1_TRESETN>;
        reset-names = "presetn", "tresetn";
        dmas = <&dmac 0xc6d9>, <&dmac 0xc6da>;
        dma-names = "tx", "rx";
        status = "disabled";
    };
```

## Documentation/devicetree/bindings/spi/renesas,rzv2h-rspi.yaml
```yaml
# SPDX-License-Identifier: (GPL-2.0-only OR BSD-2-Clause)
%YAML 1.2
---
$id: http://devicetree.org/schemas/spi/renesas,rzv2h-rspi.yaml#
$schema: http://devicetree.org/meta-schemas/core.yaml#

title: Renesas RZ/V2H(P) Renesas Serial Peripheral Interface (RSPI)

allOf:
  - $ref: spi-controller.yaml#

properties:
  compatible:
    const: renesas,rspi-v2h # RZ/V2H(P)

  reg:
    maxItems: 1

  interrupts:
    items:
      - description: Error Interrupt
      - description: Communication End Interrupt
      - description: Receive Buffer Full Interrupt
      - description: Transmit Buffer Empty Interrupt

  interrupt-names:
    items:
      - const: error
      - const: cend
      - const: rx
      - const: tx

  clocks:
    maxItems: 3

  clock-names:
    items:
      - const: pclk
      - const: pclk_sfr
      - const: tclk

  resets:
    maxItems: 2

  reset-names:
    items:
      - const: presetn
      - const: tresetn

  dmas:
    maxItems: 2

  dma-names:
    items:
      - const: tx
      - const: rx

  power-domains:
    maxItems: 1

  num-cs:
    maxItems: 1

  status:
    maxItems: 1

required:
  - compatible
  - reg
  - interrupts
  - interrupt-names
  - clocks
  - clock-names
  - resets
  - reset-names
  - dmas
  - dma-names
  - power-domains
  - num-cs
  - '#address-cells'
  - '#size-cells'
  - status

unevaluatedProperties: false

examples:
  - |
    #include <dt-bindings/interrupt-controller/arm-gic.h>
    #include <dt-bindings/clock/renesas-cpg-mssr.h>
    spi@12800800 {
	compatible = "renesas,rspi-v2h";
	reg = <0 0x12800800 0 0x400>;
	interrupts = <GIC_SPI 112 IRQ_TYPE_LEVEL_HIGH>,
		     <GIC_SPI 113 IRQ_TYPE_EDGE_RISING>,
		     <GIC_SPI 504 IRQ_TYPE_EDGE_RISING>,
		     <GIC_SPI 505 IRQ_TYPE_EDGE_RISING>;
	interrupt-names = "error", "cend", "rx", "tx";
	clocks = <&cpg CPG_MOD 90>,
		<&cpg CPG_MOD 91>,
		<&cpg CPG_MOD 92>;
	clock-names = "pclk", "pclksfr", "tclk";
	resets = <&cpg 127>,
		 <&cpg 128>;
	reset-names = "presetn", "tresetn";
	dmas = <&dmac1 0x7F4491>, <&dmac1 0x7F4490>;
	dma-names = "tx", "rx";
	power-domains = <&cpg>;
	num-cs = <1>;
	#address-cells = <1>;
	#size-cells = <0>;
	status = "disabled";
   };
```

## Documentation/devicetree/bindings/spi/renesas,spi-rsci.yaml
```yaml
# SPDX-License-Identifier: (GPL-2.0-only OR BSD-2-Clause)
%YAML 1.2
---
$id: http://devicetree.org/schemas/spi/renesas,spi-rsci.yaml#
$schema: http://devicetree.org/meta-schemas/core.yaml#

title: Renesas Serial Communication Interface (RSCI) SPI Controller

allOf:
  - $ref: spi-controller.yaml#

properties:
  compatible:
    oneOf:
      - items:
          - enum:
              - renesas,r9a08g046-rz-rsci # RZ/G3L
              - renesas,rz-rsci-spi       # RSCI SPI mode

  reg:
    maxItems: 1

  interrupts:
    oneOf:
      - items:
          - description: Error Interrupt
          - description: Receive Data Full Interrupt
          - description: Transmit Data Empty Interrupt
          - description: Transmit End Interrupt

  interrupt-names:
    oneOf:
      - items:
          - const: eri
          - const: rxi
          - const: txi
          - const: tei

  clocks:
    maxItems: 2

  clock-names:
    items:
      - const: fck
      - const: tclk

  resets:
    maxItems: 2

  reset-names:
    items:
      - const: presetn
      - const: tresetn

  dmas:
    maxItems: 2

  dma-names:
    items:
      - const: tx
      - const: rx

  power-domains:
    maxItems: 1

  num-cs:
    maxItems: 1

  status:
    maxItems: 1

if:
  properties:
    status:
      const: "okay"
then:
  properties:
    compatible:
        contains:
            const: renesas,rz-rsci-spi

required:
  - compatible
  - reg
  - interrupts
  - interrupt-names
  - clocks
  - clock-names
  - resets
  - reset-names
  - dmas
  - dma-names
  - power-domains
  - num-cs
  - '#address-cells'
  - '#size-cells'
  - status

unevaluatedProperties: false

examples:
  - |
    #include <dt-bindings/interrupt-controller/arm-gic.h>
    #include <dt-bindings/clock/r9a08g046-cpg.h>
    rsci: spi@100f1000 {
        compatible = "renesas,r9a08g046-rz-rsci", "renesas,rz-rsci-spi";
        reg = <0 0x100f1000 0 0x1000>;
        interrupts = <GIC_SPI 422 IRQ_TYPE_LEVEL_HIGH>,
                    <GIC_SPI 423 IRQ_TYPE_EDGE_RISING>,
                    <GIC_SPI 424 IRQ_TYPE_EDGE_RISING>,
                    <GIC_SPI 425 IRQ_TYPE_LEVEL_HIGH>;
        interrupt-names = "eri", "rxi", "txi", "tei";
        clocks = <&cpg CPG_MOD R9A08G046_RSCI1_PCLK>,
            <&cpg CPG_MOD R9A08G046_RSCI1_TCLK>;
        clock-names = "fck", "tclk";
        power-domains = <&cpg>;
        resets = <&cpg R9A08G046_RSCI1_PRESETN>,
            <&cpg R9A08G046_RSCI1_TRESETN>;
        reset-names = "presetn", "tresetn";
        dmas = <&dmac 0xc6d9>, <&dmac 0xc6da>;
        dma-names = "tx", "rx";
        num-cs = <1>;
        #address-cells = <1>;
        #size-cells = <0>;
        status = "disabled";
    };
```

## Documentation/devicetree/bindings/thermal/renesas,r9a09g047-tsu.yaml
```yaml
# SPDX-License-Identifier: (GPL-2.0-only OR BSD-2-Clause)
%YAML 1.2
---
$id: http://devicetree.org/schemas/thermal/renesas,r9a09g047-tsu.yaml#
$schema: http://devicetree.org/meta-schemas/core.yaml#

title: Renesas RZ/G3E Temperature Sensor Unit (TSU)

maintainers:
  - John Madieu <john.madieu.xa@bp.renesas.com>

description:
  The Temperature Sensor Unit (TSU) is an integrated thermal sensor that
  monitors the chip temperature on the Renesas RZ/G3E SoC. The TSU provides
  real-time temperature measurements for thermal management.

properties:
  compatible:
    const: renesas,r9a09g047-tsu

  reg:
    maxItems: 1

  clocks:
    maxItems: 1

  resets:
    maxItems: 1

  power-domains:
    maxItems: 1

  interrupts:
    items:
      - description: Conversion complete interrupt signal (pulse)
      - description: Comparison result interrupt signal (level)

  interrupt-names:
    items:
      - const: adi
      - const: adcmpi

  "#thermal-sensor-cells":
    const: 0

  renesas,tsu-calibration-sys:
    $ref: /schemas/types.yaml#/definitions/phandle
    description: |
      Phandle to the system controller (sys) that contains the TSU
      calibration values used for temperature calculations.

required:
  - compatible
  - reg
  - clocks
  - resets
  - power-domains
  - interrupts
  - interrupt-names
  - "#thermal-sensor-cells"
  - renesas,tsu-calibration-sys

additionalProperties: false

examples:
  - |
    #include <dt-bindings/clock/renesas,r9a09g047-cpg.h>
    #include <dt-bindings/interrupt-controller/arm-gic.h>

    tsu: thermal@14002000 {
        compatible = "renesas,r9a09g047-tsu";
        reg = <0x14002000 0x1000>;
        clocks = <&cpg CPG_MOD 266>;
        resets = <&cpg 248>;
        power-domains = <&cpg>;
        interrupts = <GIC_SPI 250 IRQ_TYPE_EDGE_RISING>,
                     <GIC_SPI 251 IRQ_TYPE_LEVEL_HIGH>;
        interrupt-names = "adi", "adcmpi";
        #thermal-sensor-cells = <0>;
        renesas,tsu-calibration-sys = <&sys>;
    };
```

## Documentation/devicetree/bindings/thermal/rzt2h-thermal.yaml
```yaml
# SPDX-License-Identifier: (GPL-2.0-only OR BSD-2-Clause)
%YAML 1.2
---
$id: http://devicetree.org/schemas/thermal/rzt2h-thermal.yaml#
$schema: http://devicetree.org/meta-schemas/core.yaml#

title: Renesas RZ/T2H Thermal Sensor Unit

description:
  On RZ/T2H SoCs, the thermal sensor unit (TSU) measures the
  temperature(Tj) inside the LSI.

maintainers:
  - Biju Das <biju.das.jz@bp.renesas.com>

$ref: rzg2l-thermal.yaml#

properties:
  compatible:
    items:
      - enum:
        - renesas,r9a09g077-tsu # RZ/T2H
        - renesas,r9a09g087-tsu # RZ/N2H
      - const: renesas,rzt2h-tsu

  reg:
    maxItems: 1

  clocks:
    maxItems: 1

  power-domains:
    maxItems: 1

  resets:
    maxItems: 1

  "#thermal-sensor-cells":
    const: 1

required:
  - compatible
  - reg
  - clocks
  - power-domains
  - resets

unevaluatedProperties: false

examples:
  - |
    #include <dt-bindings/clock/r9a09g077-cpg.h>

    tsu: thermal@80086000 {
      compatible = "renesas,r9a09g087-tsu";
      reg = <0 0x80086000 0 0x1000>;
      clocks = <&cpg CPG_MOD R9A09G077_TSU_CLK>;
      clock-names = "tsu_clk";
      #thermal-sensor-cells = <1>;
    };

    thermal-zones {
      emergency {
        polling-delay = <1000>;
        on-temperature = <110000>;
        off-temperature = <95000>;
        target_cpus =   <&cpu1 &cpu2 &cpu3>;
        status = "disabled";
      };

      sensor_thermal: sensor-thermal {
        polling-delay-passive = <250>;
        polling-delay = <1000>;
        thermal-sensors = <&tsu 0>;

        trips {
          sensor_crit: sensor-crit {
            temperature = <123000>;
            hysteresis = <1000>;
            type = "critical";
          };
        };
      };
    };
```

## Documentation/devicetree/bindings/timer/renesas,rz_cmtw.yaml
```yaml
# SPDX-License-Identifier: (GPL-2.0-only OR BSD-2-Clause)
%YAML 1.2
---
$id: http://devicetree.org/schemas/timer/renesas,cmt.yaml#
$schema: http://devicetree.org/meta-schemas/core.yaml#

title: Renesas Compare Match Timer W (CMTW)

maintainers:
  - Hien Huynh <hien.huynh.px@renesas.com>

description:
  The CMTW has 8 timer channels (4 channels x 2 units) of the 32-bit compare
  match timer W (CMTW). The CMTW has a 32-bit counter and can generate
  interrupts each time a set period elapses.

properties:
  compatible:
    items:
      - enum:
          - renesas,rzg3e-cmtw    # RZ/G3E
          - renesas,rzv2n-cmtw    # RZ/V2N
      - const: renesas,rzv2h-cmtw # RZ/V2H

  reg:
    maxItems: 1

  interrupts:
    minItems: 4
    maxItems: 4

  clocks:
    minItems: 4
    maxItems: 4

  clock-names:
    items:
      - const: fck0
      - const: fck1
      - const: fck2
      - const: fck3

  power-domains:
    maxItems: 1

  resets:
    minItems: 4
    maxItems: 4

required:
  - compatible
  - reg
  - interrupts
  - clocks
  - clock-names
  - power-domains

additionalProperties: false

examples:
  - |
    cmtw0: timer@11c01800 {
            compatible = "renesas,rzv2h-cmtw";
            reg = <0 0x11c01800 0 0x1000>;
            interrupts = <GIC_SPI 455 IRQ_TYPE_EDGE_RISING>,
                         <GIC_SPI 456 IRQ_TYPE_EDGE_RISING>,
                         <GIC_SPI 457 IRQ_TYPE_EDGE_RISING>,
                         <GIC_SPI 458 IRQ_TYPE_EDGE_RISING>;
            clocks = <&cpg CPG_MOD 0x3b>, <&cpg CPG_MOD 0x3c>,
                     <&cpg CPG_MOD 0x3d>, <&cpg CPG_MOD 0x3e>;
            clock-names = "fck0", "fck1", "fck2", "fck3";
            resets = <&cpg 0x65>, <&cpg 0x66>,
                     <&cpg 0x67>, <&cpg 0x68>;
            power-domains = <&cpg>;
    };

    cmtw1: timer@13000c00 {
            compatible = "renesas,rzv2h-cmtw";
            reg = <0 0x13000c00 0 0x1000>;
            interrupts = <GIC_SPI 459 IRQ_TYPE_EDGE_RISING>,
                         <GIC_SPI 460 IRQ_TYPE_EDGE_RISING>,
                         <GIC_SPI 461 IRQ_TYPE_EDGE_RISING>,
                         <GIC_SPI 462 IRQ_TYPE_EDGE_RISING>;
            clocks = <&cpg CPG_MOD 0x3f>, <&cpg CPG_MOD 0x40>,
                     <&cpg CPG_MOD 0x41>, <&cpg CPG_MOD 0x42>;
            clock-names = "fck0", "fck1", "fck2", "fck3";
            resets = <&cpg 0x69>, <&cpg 0x6a>,
                     <&cpg 0x6b>, <&cpg 0x6c>;
            power-domains = <&cpg>;
    };
```
