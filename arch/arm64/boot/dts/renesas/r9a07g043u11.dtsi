// SPDX-License-Identifier: (GPL-2.0-only OR BSD-2-Clause)
/*
 * Device Tree Source for the RZ/G2UL R9A07G043U11 SoC specific parts
 *
 * Copyright (C) 2022 Renesas Electronics Corp.
 */

/dts-v1/;
#include "r9a07g043.dtsi"

/ {
	compatible = "renesas,r9a07g043ul1", "renesas,r9a07g043";
};
