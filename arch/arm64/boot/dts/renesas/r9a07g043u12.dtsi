// SPDX-License-Identifier: (GPL-2.0-only OR BSD-2-Clause)
/*
 * Device Tree Source for the RZ/G2UL R9A07G043U12 SoC specific parts
 *
 * Copyright (C) 2022 Renesas Electronics Corp.
 */

/dts-v1/;
#include "r9a07g043.dtsi"

/ {
	compatible = "renesas,r9a07g043ul2", "renesas,r9a07g043";

	soc: soc {
		/delete-node/ adc@10059000;
		/delete-node/ ethernet@11c30000;
		/delete-node/ vsp@10870000;
		/delete-node/ display@10890000;
		/delete-node/ ssi@1004A800;
	};
};
