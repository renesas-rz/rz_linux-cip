// SPDX-License-Identifier: (GPL-2.0-only OR BSD-2-Clause)
/*
 * Device Tree Source for the RZ/G3S Development board (13mm_LPDDR4)
 *
 * Copyright (C) 2023 Renesas Electronics Corp.
 */

/dts-v1/;

/*
 * Select between USB2 phy0 and MTU3 pins which are multiplexed
 * MTU3 pins are NOT required, if only use clocksource/clockevent
 * functions.
 */
#define MTU3_PINS_SEL			0

/*
 * POE3_SUPPORT is used to enable POE0/4 to control Hi-Z state of complementary PWM
 * signals at MTIOC7A-MTIOC7C. Note: This macro must be enabled along with macros
 * COMMON_PINS_SEL=3 to fully take effect.
 */
#define POE3_SUPPORT			0

/*
 * RSPI2_PINS_SEL - select between RSPI ch2 and POEG, GPT pins
 * RSPI2_LOOPBACK_SEL - select target SPI device
 * 			(N25Q256A flash with Digilent PMOD SF3 by default)
 */
#define RSPI2_PINS_SEL			1
#define RSPI2_LOOPBACK_SEL		0

#include "r9a08g045.dtsi"
#include "rzg3s-dev-common.dtsi"

/ {
	model = "Renesas Development EVK based on r9a08g045s31";
	compatible = "renesas,r9a08g045",
		     "renesas,r9a08g045s31", "renesas,r9a08g045s31-dev";
};
