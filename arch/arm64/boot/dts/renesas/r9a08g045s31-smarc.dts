// SPDX-License-Identifier: (GPL-2.0-only OR BSD-2-Clause)
/*
 * Device Tree Source for the RZ/G3S SMARC-2 board
 *
 * Copyright (C) 2023 Renesas Electronics Corp.
 */

/dts-v1/;
#include "r9a08g045.dtsi"
#include "rzg3s-smarc-pinfunction.dtsi"
#include "rzg3s-smarc-som.dtsi"
#include "rzg3s-smarc.dtsi"

/ {
	model = "Renesas SMARC EVK version2 based on r9a08g045s";
	compatible = "renesas,smarc-evk", "renesas,r9a08g045", "renesas,r9a08g045s31";
};
