// SPDX-License-Identifier: (GPL-2.0-only OR BSD-2-Clause)
/*
 * Device Tree Source for the RZ/G3S SMARC Carrier II EVK PMOD parts
 *
 * Copyright (C) 2026 Renesas Electronics Corp.
 *
 *
 * [Connection]
 *
 * SMARC Carrier II EVK
 * +-------------------------------------------------+
 * |PMOD0_2A (PMOD0 PIN HEADER)                      |
 * |    SPI1_CS0#    (pin1)  (pin7)  PMOD0_GPIO4     |
 * |    SPI1_MOSI    (pin2)  (pin8)  PMOD0_GPIO5     |
 * |    SPI1_MISO    (pin3)  (pin9)  PMOD0_GPIO/CS2  |
 * |    SPI1_SCK     (pin4)  (pin10) PMOD0_GPIO/CS3  |
 * |    GND          (pin5)  (pin11) GND             |
 * |    PWR_PMOD0    (pin6)  (pin12) PWR_PMOD0       |
 * +-------------------------------------------------+
 *
 */

/dts-v1/;
/plugin/;
/*
 * Select target SPI device between virtual loopback
 * and Pmod SF3 flash on PMOD (default):
 * RSPI0_LOOPBACK_SEL
 */
#define RSPI0_LOOPBACK_SEL      0
#define RSPI_FLASH_EN           0


#include <dt-bindings/pinctrl/rzg2l-pinctrl.h>
#include "rzg3s-smarc-switches.h"

&pinctrl {
	spi0_pins: spi0 {
                pinmux = <RZG2L_PORT_PINMUX(15, 0, 1)>, /* CK */
                         <RZG2L_PORT_PINMUX(15, 1, 1)>, /* MOSI */
                         <RZG2L_PORT_PINMUX(15, 2, 1)>, /* MISO */
                         <RZG2L_PORT_PINMUX(15, 3, 1)>; /* SSL */
        };
};

&spi0 {
        pinctrl-0 = <&spi0_pins>;
        pinctrl-names = "default";
	#address-cells = <1>;
        #size-cells = <0>;
        status = "okay";

#if RSPI0_LOOPBACK_SEL
        spidev@0 {
                compatible = "rohm,dh2228fv";
                reg = <0>;
                spi-max-frequency = <50000000>;
        };
#elif RSPI_FLASH_EN
        flash0: mt25ql256a@0 {
                compatible = "micron,mt25ql256a", "jedec,spi-nor";
                reg = <0>;
                spi-max-frequency = <9500000>;
                spi-tx-bus-width = <1>;
                spi-rx-bus-width = <1>;
                m25p,fast-read;

                partitions {
                        compatible = "fixed-partitions";
                        #address-cells = <1>;
                        #size-cells = <1>;

                        scratch@0 {
                                reg = <0x00000000 0x2000000>;
                        };
                };
        };
#endif
};
