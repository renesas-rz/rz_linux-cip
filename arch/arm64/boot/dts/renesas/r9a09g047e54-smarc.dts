// SPDX-License-Identifier: (GPL-2.0-only OR BSD-2-Clause)
/*
 * Device Tree Source for the RZ/G3E SMARC EVK board
 *
 * Copyright (C) 2024 Renesas Electronics Corp.
 */

/dts-v1/;
/* Switch selection settings */
#define SW_SD0_DEV_SEL			0
#define SW_SDIO_M2E			0

#include "rzg3e-smarc-common.dtsi"
