// SPDX-License-Identifier: GPL-2.0
/*
 * DT overlay for the RZ/T2H EVK with ADV7513 transmitter
 * connected to DU enabled.
 *
 * Copyright (C) 2026 Renesas Electronics Corp.
 */

/dts-v1/;
/plugin/;

/*
 * RZ/T2H LCDC configuration:
 * ----------------------------------------------------------
 * Function        Pin     SW Setting
 * ----------------------------------------------------------
 * LCDC_DATG0     P11_0, SW6[3]: OFF, SW6[4]: ON, SW6[5]: OFF
 * LCDC_DATB1     P18_0, SW8[3]: OFF, SW8[4]: ON
 * LCDC_DATB2     P18_1, SW8[1]: OFF, SW8[2]: ON
 * HEADER_IRQ8    P22_6, SW2[1]: ON, SW2[2]: OFF
 */
#include "rzt2h-n2h-evk-du-adv7513.dtsi"

&{/leds/led-4} {
	/* P18_0 is used for DU function LCDC_DATB1. */
	status = "disabled";
};

&{/leds/led-5} {
	/* P18_1 is used for DU function LCDC_DATB2. */
	status = "disabled";
};

/*
 * Disable SDHI0 as SW2 settings for eMMC/SD card conflict with DU pin
 * settings.
 */
&sdhi0 {
	status = "disabled";
};
