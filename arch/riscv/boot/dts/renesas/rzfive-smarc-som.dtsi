// SPDX-License-Identifier: (GPL-2.0-only OR BSD-2-Clause)
/*
 * Device Tree Source for the RZ/Five SMARC EVK SOM
 *
 * Copyright (C) 2022 Renesas Electronics Corp.
 */

#include <arm64/renesas/rzg2ul-smarc-som.dtsi>

&sbc {
	spi-tx-bus-width = <1>;
	spi-rx-bus-width = <1>;
};
